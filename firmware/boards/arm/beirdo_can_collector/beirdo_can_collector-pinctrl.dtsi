/*
 * Copyright (c) 2022 Gavin Hurlbut
 * SPDX-License-Identifier: Apache-2.0
 */

#include <dt-bindings/pinctrl/samc21j-pinctrl.h>

&pinctrl {
	pwm_default: pwm_default {
		group1 {
			pinmux = <PB30E_TCC0_WO0>,
                                 <PB31E_TCC0_WO1>,
				 <PA28A_EXTINT8>;
		};
	};

	adc0_default: adc0_default {
		group1 {
			pinmux = <PA9B_ADC0_AIN9>;
		};
	};

	adc1_default: adc1_default {
		group1 {
			pinmux = <PB0B_ADC1_AIN0>;
		};
	};

	sercom0_uart_default: sercom0_uart_default {
                hw-flow-control;
		group1 {
			pinmux = <PA4D_SERCOM0_PAD0>, <PA6D_SERCOM0_PAD2>;
		};
		group2 {
			pinmux = <PA6D_SERCOM0_PAD1>, <PA6D_SERCOM0_PAD3>;
			bias-pull-up;
		};
	};

	sercom1_uart_default: sercom1_uart_default {
		group1 {
			pinmux = <PA0D_SERCOM1_PAD0>;
		};
		group2 {
			pinmux = <PA1D_SERCOM1_PAD1>;
			bias-pull-up;
		};
	};

	sercom2_uart_default: sercom2_uart_default {
		group1 {
			pinmux = <PA8D_SERCOM2_PAD0>;
		};
		group2 {
			bias-pull-up;
			pinmux = <PA10D_SERCOM2_PAD2>;
		};
	};


	sercom3_spi_default: sercom3_spi_default {
		group1 {
			pinmux = <PA22C_SERCOM3_PAD0>,
				 <PA23C_SERCOM3_PAD1>,
				 <PA25C_SERCOM3_PAD3>;
		};
		group2 {
			bias-pull-up;
			pinmux = <PA24C_SERCOM3_PAD2>,
		};
	};

	sercom4_spi_default: sercom4_spi_default {
		group1 {
			pinmux = <PA12D_SERCOM4_PAD0>,
				 <PA13D_SERCOM4_PAD1>,
				 <PB11D_SERCOM4_PAD3>;
		};
		group2 {
			bias-pull-up;
			pinmux = <PB10D_SERCOM4_PAD2>,
				 <PA11A_EXTINT11>;
		};
	};

	sercom5_i2c_default: sercom5_i2c_default {
		group1 {
			bias-pull-up;
			pinmux = <PB16C_SERCOM5_PAD0>,
				 <PB17C_SERCOM5_PAD1>;
		};
	};

	can0_default: can0_default {
		group1 {
			pinmux = <PB22G_CAN0_TX PB23G_CAN0_RX>;
		};
	};

	can1_default: can1_default {
		group1 {
			pinmux = <PB14G_CAN1_TX PB15G_CAN1_RX>;
		};
	};

};
