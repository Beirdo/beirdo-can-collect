## firmware/boards/arm/beirdo_can_collector/Kconfig.board
```kconfig
# Beirdo's Vehicle CAN Collector configuration

# Copyright (c) 2022 Gavin Hurlbut
# SPDX-License-Identifier: Apache-2.0

config BOARD_BEIRDO_CAN_COLLECTOR
	bool "Beirdo's Vehicle CAN Collector"
	depends on SOC_PART_NUMBER_SAMC21J18A
```

## firmware/boards/arm/beirdo_can_collector/Kconfig.defconfig
```kconfig
# Beirdo's Vehicle CAN Collector configuration

# Copyright (c) 2022 Gavin Hurlbut
# SPDX-License-Identifier: Apache-2.0

config BOARD
	default "beirdo_can_collector"
	depends on BOARD_BEIRDO_CAN_COLLECTOR
```

## firmware/boards/arm/beirdo_can_collector/beirdo_can_collector_defconfig
```kconfig
# Copyright (c) 2022 Gavin Hurlbut
# SPDX-License-Identifier: Apache-2.0
CONFIG_SOC_SERIES_SAMC21=y
CONFIG_SOC_PART_NUMBER_SAMC21J18A=y
CONFIG_BOARD_BEIRDO_CAN_COLLECTOR=y
CONFIG_BUILD_OUTPUT_HEX=y
CONFIG_CONSOLE=y
CONFIG_UART_CONSOLE=y
CONFIG_SERIAL=y
CONFIG_UART_INTERRUPT_DRIVEN=y
CONFIG_GPIO=y
```
